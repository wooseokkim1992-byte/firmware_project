
#include "oled.h"
#include "i2c.h"
#include "main.h"
#include "stm32f411xe.h"
#include "stm32f4xx_hal_def.h"
#include "stm32f4xx_hal_i2c.h"
#include <stdarg.h>
#include <stdint.h>
#include <stdio.h>
#include <sys/syslimits.h>

static uint8_t ssd1306_buffer[SSD1306_BUFFER_SIZE];
static uint8_t ssd1306_dma_buffer[SSD1306_BUFFER_SIZE];
static volatile bool ssd1306_dma_busy = false;
static volatile uint32_t ssd1306_i2c_error = HAL_I2C_ERROR_NONE;

/* 6x8 Basic ASCII Font Table (ASCII 0x20 ' ' to 0x7E '~') */
static const uint8_t font6x8[][6] = {
    {0x00, 0x00, 0x00, 0x00, 0x00, 0x00}, // ' '
    {0x00, 0x00, 0x5F, 0x00, 0x00, 0x00}, // '!'
    {0x00, 0x07, 0x00, 0x07, 0x00, 0x00}, // '"'
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    {0x08, 0x08, 0x2A, 0x1C, 0x08, 0x00}  // '~'
};

static bool writeCommand(uint8_t cmd) {
  return HAL_I2C_Mem_Write(&hi2c1, SSD1306_I2C_ADDR, 0x00, 1, &cmd, 1, 10) ==
         HAL_OK;
}

static bool setDisplayAddressWindow(void) {
  // set column address
  if (!writeCommand(0x21))
    return false;
  if (!writeCommand(0))
    return false;
  if (!writeCommand(SSD1306_WIDTH - 1))
    return false;
  // set page address
  if (!writeCommand(0x22))
    return false;
  if (!writeCommand(0))
    return false;
  if (!writeCommand((SSD1306_HEIGHT / 8) - 1))
    return false;
  return true;
}

void ssd1306Clear(void) {
  memset(ssd1306_buffer, 0x00, sizeof(ssd1306_buffer));
}

void ssd1306Update(void) {
  if (!setDisplayAddressWindow())
    return;

  HAL_I2C_Mem_Write(&hi2c1, SSD1306_I2C_ADDR, 0x40, 1, ssd1306_buffer,
                    sizeof(ssd1306_buffer), 100);
}

void ssd1306DrawPixel(int16_t x, int16_t y, uint8_t color) {
  if (x < 0 || x >= SSD1306_WIDTH || y < 0 || y >= SSD1306_HEIGHT) {
    return;
  }

  if (color == SSD1306_COLOR_WHITE) {
    ssd1306_buffer[x + (y / 8) * SSD1306_WIDTH] |= (1 << (y % 8));
  } else {
    ssd1306_buffer[x + (y / 8) * SSD1306_WIDTH] &= ~(1 << (y % 8));
  }
}

bool ssd1306Init(void) {
  // 디바이스 응답 확인
  if (HAL_I2C_IsDeviceReady(&hi2c1, SSD1306_I2C_ADDR, 2, 10) != HAL_OK) {
    return false;
  }

  HAL_Delay(10);

  // SSD1306 초기화 시퀀스
  writeCommand(0xAE); // Display OFF

  writeCommand(0x20); // Set Memory Addressing Mode
  writeCommand(0x00); // 00: Horizontal Addressing Mode

  writeCommand(0xB0); // Set Page Start Address for Page Addressing Mode,0-7

  writeCommand(0xC8); // Set COM Output Scan Direction (Reversed)
  writeCommand(0x00); // Set low column address
  writeCommand(0x10); // Set high column address

  writeCommand(0x40); // Set start line address

  writeCommand(0x81); // Set contrast control register
  writeCommand(0xFF);

  writeCommand(0xA1); // Set Segment Re-map (0 to 127)

  writeCommand(0xA6); // Set Normal display (0xA7: Inverse)

  writeCommand(0xA8); // Set multiplex ratio(1 to 64)
  writeCommand(0x3F); // 1/64 duty

  writeCommand(
      0xA4); // 0xA4: Output follows RAM content; 0xA5: Entire display ON

  writeCommand(0xD3); // Set display offset
  writeCommand(0x00); // Not offset

  writeCommand(0xD5); // Set display clock divide ratio/oscillator frequency
  writeCommand(0xF0); // Set divide ratio

  writeCommand(0xD9); // Set pre-charge period
  writeCommand(0x22);

  writeCommand(0xDA); // Set com pins hardware configuration
  writeCommand(0x12);

  writeCommand(0xDB); // Set vcomh
  writeCommand(0x20); // 0x20: 0.77xVcc

  writeCommand(0x8D); // Set DC-DC enable
  writeCommand(0x14); // Enable charge pump

  writeCommand(0xAF); // Display ON

  ssd1306Clear();
  ssd1306Update();

  return true;
}

bool ssd1306UpdateDMA(void) {
  // 이전 화면이 DMA 통해 전송중일 때, 새 전송을 시작하지 않는다.
  if (isSsd1306DMABusy()) {
    return false;
  }
  if (!setDisplayAddressWindow()) {
    ssd1306_i2c_error = HAL_I2C_GetError(&hi2c1);
    return false;
  }

  memcpy(ssd1306_dma_buffer, ssd1306_buffer, sizeof(ssd1306_buffer));
  ssd1306_dma_busy = true;
  ssd1306_i2c_error = HAL_I2C_ERROR_NONE;

  if (HAL_I2C_Mem_Write_DMA(&hi2c1, SSD1306_I2C_ADDR, 0x40,
                            I2C_MEMADD_SIZE_8BIT, ssd1306_dma_buffer,
                            sizeof(ssd1306_dma_buffer)) != HAL_OK) {
    ssd1306_dma_busy = false;
    ssd1306_i2c_error = HAL_I2C_GetError(&hi2c1);
    return false;
  }
  return true;
}

bool isSsd1306DMABusy() {
  return ssd1306_dma_busy ||
         HAL_I2C_GetState(&hi2c1) != HAL_I2C_STATE_READY;
}

void ssd1306DrawLine(int16_t x0, int16_t y0, int16_t x1, int16_t y1,
                     uint8_t color) {
  int16_t dx = abs(x1 - x0);
  int16_t sx = x0 < x1 ? 1 : -1;
  int16_t dy = -abs(y1 - y0);
  int16_t sy = y0 < y1 ? 1 : -1;
  int16_t err = dx + dy;
  int16_t e2;

  while (1) {
    ssd1306DrawPixel(x0, y0, color);
    if (x0 == x1 && y0 == y1)
      break;
    e2 = 2 * err;
    if (e2 >= dy) {
      err += dy;
      x0 += sx;
    }
    if (e2 <= dx) {
      err += dx;
      y0 += sy;
    }
  }
}
void ssd1306DrawRect(int16_t x, int16_t y, int16_t w, int16_t h,
                     uint8_t color) {
  ssd1306DrawLine(x, y, x + w - 1, y, color);
  ssd1306DrawLine(x, y + h - 1, x + w - 1, y + h - 1, color);
  ssd1306DrawLine(x, y, x, y + h - 1, color);
  ssd1306DrawLine(x + w - 1, y, x + w - 1, y + h - 1, color);
}

void ssd1306FillRect(int16_t x, int16_t y, int16_t w, int16_t h,
                     uint8_t color) {
  for (uint16_t i = x; i < x + w; i++) {
    for (uint16_t j = y; j < y + h; j++) {
      ssd1306DrawPixel(i, j, color);
    }
  }
}
void ssd1306DrawChar(int16_t x, int16_t y, char ch, uint8_t color) {
  if (ch < ' ' || ch > '~') {
    return;
  }
  uint8_t index = ch - ' ';

  for (uint8_t i = 0; i < 6; i++) {
    uint8_t line = font6x8[index][i];
    for (uint8_t j = 0; j < 8; j++) {
      if (line & (1 << j)) {
        ssd1306DrawPixel(x + i, y + j, color);
      } else {
        ssd1306DrawPixel(x + i, y + j, !color);
      }
    }
  }
}
void ssd1306DrawString(int16_t x, int16_t y, const char *str, uint8_t color) {
  while (*str) {
    ssd1306DrawChar(x, y, *str, color);
    x += 6;
    str++;
  }
}

void HAL_I2C_MemTxCpltCallback(I2C_HandleTypeDef *hi2c) {
  if (hi2c->Instance == I2C1) {
    ssd1306_dma_busy = false;
    ssd1306_i2c_error = HAL_I2C_ERROR_NONE;
  }
}

void HAL_I2C_ErrorCallback(I2C_HandleTypeDef *hi2c) {
  if (hi2c->Instance == I2C1) {
    ssd1306_dma_busy = false;
    ssd1306_i2c_error = HAL_I2C_GetError(&hi2c1);
  }
}
